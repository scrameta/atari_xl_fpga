-------------------------------------------------------------------------------
-- AMY1: the core with its memories. Generated by vhdlgen.py.
-------------------------------------------------------------------------------
library ieee;
use ieee.std_logic_1164.all;
use ieee.numeric_std.all;

entity amy1 is
  generic (
    -- Repair the noise generators' pseudo-random registers (see below). false = the
    -- netlist as drawn, where A, B and C get no feedback and freeze within 15 updates.
    NOISE_FIX : boolean := true
  );
  port (
    clk          : in  std_logic;
    step_en      : in  std_logic;                      -- advance one sequencer step

    -- chip pins (active low as on the real part; CLOCK is replaced by step_en)
    pin_resetn   : in  std_logic;
    pin_test     : in  std_logic;
    pin_oen      : in  std_logic;
    pin_csn      : in  std_logic;
    pin_wrn      : in  std_logic;
    pin_rdn      : in  std_logic;
    pin_a        : in  std_logic_vector(1 downto 0);
    pin_db_in    : in  std_logic_vector(7 downto 0);
    pin_db_drive : in  std_logic;                      -- host is driving DB
    pin_db_out   : out std_logic_vector(7 downto 0);
    pin_db_oe    : out std_logic_vector(7 downto 0);
    pin_intrdy   : out std_logic;                      -- READY mode: low while a command runs
    pin_samp     : out std_logic_vector(15 downto 0);  -- SAMP0 is muxed with bit 16 on the pin
    pin_outstbn  : out std_logic;                      -- OUTSTBN/T1 pad
    pin_v0       : out std_logic;                      -- V0/T0 pad: voice 0 (INDIVIDUAL mode)

    -- internal 17-bit sample latch (use this rather than pin_samp)
    samp_latch   : out std_logic_vector(16 downto 0);
    samp_load    : out std_logic;                      -- LDSAMP: latch is being loaded

    -- memory load port (fill all memories before releasing reset)
    load_we   : in  std_logic;                      -- write one image word
    load_addr : in  std_logic_vector(10 downto 0);
    load_data : in  std_logic_vector(31 downto 0);
    -- auxiliary port on the VOICE block RAM (words 16..255; the packed layout only)
    aux_re    : in  std_logic := '0';                      -- read aux_raddr ...
    aux_raddr : in  std_logic_vector(7 downto 0) := (others => '0');
    aux_rack  : out std_logic;                             -- ... accepted: data next clock
    aux_rdata : out std_logic_vector(35 downto 0);        -- valid the clock after aux_rack
    aux_we    : in  std_logic := '0';                      -- write aux_wdata to aux_waddr ...
    aux_waddr : in  std_logic_vector(7 downto 0) := (others => '0');
    aux_wdata : in  std_logic_vector(35 downto 0) := (others => '0');
    aux_wack  : out std_logic                             -- ... done at this edge
  );
end entity;

architecture rtl of amy1 is
  signal noise_init : std_logic;
  signal phaseram_addr : std_logic_vector(2 downto 0);
  signal phaseram_we : std_logic;
  signal phaseram_wdata : std_logic_vector(19 downto 0);
  signal phaseram_q : std_logic_vector(19 downto 0);
  signal noise_addr : std_logic_vector(5 downto 0);
  signal noise_we : std_logic;
  signal noise_wdata : std_logic_vector(2 downto 0);
  signal noise_q : std_logic_vector(2 downto 0);
  signal lhpram_addr : std_logic_vector(5 downto 0);
  signal lhpram_we : std_logic;
  signal lhpram_wdata : std_logic_vector(0 downto 0);
  signal lhpram_q : std_logic_vector(0 downto 0);
  signal harmbrkpoint_addr : std_logic_vector(5 downto 0);
  signal harmbrkpoint_we : std_logic;
  signal harmbrkpoint_wdata : std_logic_vector(15 downto 0);
  signal harmbrkpoint_q : std_logic_vector(15 downto 0);
  signal harmcurntval_addr : std_logic_vector(5 downto 0);
  signal harmcurntval_we : std_logic;
  signal harmcurntval_wdata : std_logic_vector(12 downto 0);
  signal harmcurntval_q : std_logic_vector(12 downto 0);
  signal voice18_addr : std_logic_vector(3 downto 0);
  signal voice18_we : std_logic;
  signal voice18_wdata : std_logic_vector(17 downto 0);
  signal voice18_q : std_logic_vector(17 downto 0);
  signal voice3_addr : std_logic_vector(3 downto 0);
  signal voice3_we : std_logic;
  signal voice3_wdata : std_logic_vector(2 downto 0);
  signal voice3_q : std_logic_vector(2 downto 0);
  signal octspl_addr : std_logic_vector(4 downto 0);
  signal octspl_q : std_logic_vector(3 downto 0);
  signal xrombs_addr : std_logic_vector(6 downto 0);
  signal xrombs_q : std_logic_vector(14 downto 0);
  signal xromint_addr : std_logic_vector(6 downto 0);
  signal xromint_q : std_logic_vector(4 downto 0);
  signal srombs_addr : std_logic_vector(7 downto 0);
  signal srombs_q : std_logic_vector(16 downto 0);
  signal sromint_addr : std_logic_vector(8 downto 0);
  signal sromint_q : std_logic_vector(4 downto 0);
  signal noise_wcore : std_logic_vector(2 downto 0);
  type nf_t is array (0 to 1) of std_logic_vector(2 downto 0);
  signal nf_acc, nf_fb : nf_t := (others => (others => '0'));
  signal nf_ok : std_logic_vector(1 downto 0) := "00";
  signal nf_wl : std_logic := '0';                   -- noise_we in the previous step
begin

  -- Noise generator PRB repair (NOISE_FIX)
  nf_p: process (noise_addr, noise_we, noise_wcore, noise_init, nf_ok, nf_fb)
    variable g : integer range 0 to 1;
  begin
    g := 0; if noise_addr(0) = '1' then g := 1; end if;
    noise_wdata <= noise_wcore;
    if NOISE_FIX and noise_init = '0' and noise_addr(5 downto 1) = "00000" and nf_ok(g) = '1' then
      noise_wdata <= nf_fb(g);
    end if;
  end process;

  nf_r: process (clk)
    variable g : integer range 0 to 1;
  begin
    if rising_edge(clk) then
      if step_en = '1' then
        g := 0; if noise_addr(0) = '1' then g := 1; end if;
        nf_wl <= noise_we;
        if noise_init = '1' then
          nf_ok <= "00";
        elsif noise_we = '1' and nf_wl = '0' then        -- first step of a write
          case to_integer(unsigned(noise_addr(5 downto 1))) is
            when 0      => nf_acc(g) <= noise_wdata;
            when 3 | 8  => nf_acc(g) <= nf_acc(g) xor noise_wcore;
            when 14     => nf_fb(g) <= nf_acc(g) xor noise_wcore; nf_ok(g) <= '1';
            when others => null;
          end case;
        end if;
      end if;
    end if;
  end process;

  core: entity work.amy1_core port map (
    clk => clk,
    step_en => step_en,
    pin_resetn => pin_resetn,
    pin_test => pin_test,
    pin_oen => pin_oen,
    pin_csn => pin_csn,
    pin_wrn => pin_wrn,
    pin_rdn => pin_rdn,
    pin_a => pin_a,
    pin_db_in => pin_db_in,
    pin_db_drive => pin_db_drive,
    pin_db_out => pin_db_out,
    pin_db_oe => pin_db_oe,
    pin_intrdy => pin_intrdy,
    pin_samp => pin_samp,
    pin_outstbn => pin_outstbn,
    pin_v0 => pin_v0,
    samp_latch => samp_latch,
    samp_load => samp_load,
    noise_init => noise_init,
    phaseram_addr => phaseram_addr,
    phaseram_we => phaseram_we,
    phaseram_wdata => phaseram_wdata,
    phaseram_q => phaseram_q,
    noise_addr => noise_addr,
    noise_we => noise_we,
    noise_wdata => noise_wcore,
    noise_q => noise_q,
    lhpram_addr => lhpram_addr,
    lhpram_we => lhpram_we,
    lhpram_wdata => lhpram_wdata,
    lhpram_q => lhpram_q,
    harmbrkpoint_addr => harmbrkpoint_addr,
    harmbrkpoint_we => harmbrkpoint_we,
    harmbrkpoint_wdata => harmbrkpoint_wdata,
    harmbrkpoint_q => harmbrkpoint_q,
    harmcurntval_addr => harmcurntval_addr,
    harmcurntval_we => harmcurntval_we,
    harmcurntval_wdata => harmcurntval_wdata,
    harmcurntval_q => harmcurntval_q,
    voice18_addr => voice18_addr,
    voice18_we => voice18_we,
    voice18_wdata => voice18_wdata,
    voice18_q => voice18_q,
    voice3_addr => voice3_addr,
    voice3_we => voice3_we,
    voice3_wdata => voice3_wdata,
    voice3_q => voice3_q,
    octspl_addr => octspl_addr,
    octspl_q => octspl_q,
    xrombs_addr => xrombs_addr,
    xrombs_q => xrombs_q,
    xromint_addr => xromint_addr,
    xromint_q => xromint_q,
    srombs_addr => srombs_addr,
    srombs_q => srombs_q,
    sromint_addr => sromint_addr,
    sromint_q => sromint_q
  );

  mem: entity work.amy1_mem(packed) port map (     -- or (rtl): the reference layout
    clk => clk,
    step_en => step_en,
    load_we => load_we,
    load_addr => load_addr,
    load_data => load_data,
    aux_re => aux_re,
    aux_raddr => aux_raddr,
    aux_rack => aux_rack,
    aux_rdata => aux_rdata,
    aux_we => aux_we,
    aux_waddr => aux_waddr,
    aux_wdata => aux_wdata,
    aux_wack => aux_wack,
    phaseram_addr => phaseram_addr,
    phaseram_we => phaseram_we,
    phaseram_wdata => phaseram_wdata,
    phaseram_q => phaseram_q,
    noise_addr => noise_addr,
    noise_we => noise_we,
    noise_wdata => noise_wdata,
    noise_q => noise_q,
    lhpram_addr => lhpram_addr,
    lhpram_we => lhpram_we,
    lhpram_wdata => lhpram_wdata,
    lhpram_q => lhpram_q,
    harmbrkpoint_addr => harmbrkpoint_addr,
    harmbrkpoint_we => harmbrkpoint_we,
    harmbrkpoint_wdata => harmbrkpoint_wdata,
    harmbrkpoint_q => harmbrkpoint_q,
    harmcurntval_addr => harmcurntval_addr,
    harmcurntval_we => harmcurntval_we,
    harmcurntval_wdata => harmcurntval_wdata,
    harmcurntval_q => harmcurntval_q,
    voice18_addr => voice18_addr,
    voice18_we => voice18_we,
    voice18_wdata => voice18_wdata,
    voice18_q => voice18_q,
    voice3_addr => voice3_addr,
    voice3_we => voice3_we,
    voice3_wdata => voice3_wdata,
    voice3_q => voice3_q,
    octspl_addr => octspl_addr,
    octspl_q => octspl_q,
    xrombs_addr => xrombs_addr,
    xrombs_q => xrombs_q,
    xromint_addr => xromint_addr,
    xromint_q => xromint_q,
    srombs_addr => srombs_addr,
    srombs_q => srombs_q,
    sromint_addr => sromint_addr,
    sromint_q => sromint_q
  );

end architecture;
