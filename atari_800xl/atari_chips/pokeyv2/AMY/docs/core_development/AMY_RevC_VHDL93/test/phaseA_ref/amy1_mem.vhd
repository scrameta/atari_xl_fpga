-------------------------------------------------------------------------------
-- AMY1 memories: one block each, read synchronously at the step boundary
-- (old data on a write), filled from the load image before the chip runs.
-- Generated by vhdlgen.py. This is the reference layout; a packed layout must
-- give the same data in the same step.
-------------------------------------------------------------------------------
library ieee;
use ieee.std_logic_1164.all;
use ieee.numeric_std.all;
use work.amy1_mem_pkg.all;

entity amy1_mem is
  port (
    clk     : in  std_logic;
    step_en : in  std_logic;

    load_we   : in  std_logic;                      -- write one image word
    load_addr : in  std_logic_vector(10 downto 0);
    load_data : in  std_logic_vector(31 downto 0);

    -- auxiliary port on the VOICE block RAM (words 16..255; the packed layout only)
    aux_re    : in  std_logic := '0';                      -- read aux_raddr ...
    aux_raddr : in  std_logic_vector(7 downto 0) := (others => '0');
    aux_rack  : out std_logic;                             -- ... accepted: data next clock
    aux_rdata : out std_logic_vector(35 downto 0);        -- valid the clock after aux_rack
    aux_we    : in  std_logic := '0';                      -- write aux_wdata to aux_waddr ...
    aux_waddr : in  std_logic_vector(7 downto 0) := (others => '0');
    aux_wdata : in  std_logic_vector(35 downto 0) := (others => '0');
    aux_wack  : out std_logic;                             -- ... done at this edge

    phaseram_addr : in  std_logic_vector(2 downto 0);
    phaseram_we : in  std_logic;
    phaseram_wdata : in  std_logic_vector(19 downto 0);
    phaseram_q : out std_logic_vector(19 downto 0);
    noise_addr : in  std_logic_vector(5 downto 0);
    noise_we : in  std_logic;
    noise_wdata : in  std_logic_vector(2 downto 0);
    noise_q : out std_logic_vector(2 downto 0);
    lhpram_addr : in  std_logic_vector(5 downto 0);
    lhpram_we : in  std_logic;
    lhpram_wdata : in  std_logic_vector(0 downto 0);
    lhpram_q : out std_logic_vector(0 downto 0);
    harmbrkpoint_addr : in  std_logic_vector(5 downto 0);
    harmbrkpoint_we : in  std_logic;
    harmbrkpoint_wdata : in  std_logic_vector(15 downto 0);
    harmbrkpoint_q : out std_logic_vector(15 downto 0);
    harmcurntval_addr : in  std_logic_vector(5 downto 0);
    harmcurntval_we : in  std_logic;
    harmcurntval_wdata : in  std_logic_vector(12 downto 0);
    harmcurntval_q : out std_logic_vector(12 downto 0);
    voice18_addr : in  std_logic_vector(3 downto 0);
    voice18_we : in  std_logic;
    voice18_wdata : in  std_logic_vector(17 downto 0);
    voice18_q : out std_logic_vector(17 downto 0);
    voice3_addr : in  std_logic_vector(3 downto 0);
    voice3_we : in  std_logic;
    voice3_wdata : in  std_logic_vector(2 downto 0);
    voice3_q : out std_logic_vector(2 downto 0);
    octspl_addr : in  std_logic_vector(4 downto 0);
    octspl_q : out std_logic_vector(3 downto 0);
    xrombs_addr : in  std_logic_vector(6 downto 0);
    xrombs_q : out std_logic_vector(14 downto 0);
    xromint_addr : in  std_logic_vector(6 downto 0);
    xromint_q : out std_logic_vector(4 downto 0);
    srombs_addr : in  std_logic_vector(7 downto 0);
    srombs_q : out std_logic_vector(16 downto 0);
    sromint_addr : in  std_logic_vector(8 downto 0);
    sromint_q : out std_logic_vector(4 downto 0)
  );
end entity;

architecture rtl of amy1_mem is
  signal phaseram_mem : phaseram_t;
  signal noise_mem : noise_t;
  signal lhpram_mem : lhpram_t;
  signal harmbrkpoint_mem : harmbrkpoint_t;
  signal harmcurntval_mem : harmcurntval_t;
  signal voice18_mem : voice18_t;
  signal voice3_mem : voice3_t;
  signal octspl_mem : octspl_t;
  signal xrombs_mem : xrombs_t;
  signal xromint_mem : xromint_t;
  signal srombs_mem : srombs_t;
  signal sromint_mem : sromint_t;
begin

  aux_rack  <= '0';
  aux_wack  <= '0';
  aux_rdata <= (others => '0');

  -- RAM PHASERAM: 8 x 20
  phaseram_p: process (clk)
  begin
    if rising_edge(clk) then
      if load_we = '1' then
        if unsigned(load_addr(10 downto 3)) = PHASERAM_BASE / 8 then
          phaseram_mem(to_integer(unsigned(load_addr(2 downto 0)))) <= load_data(PHASERAM_LSB + 19 downto PHASERAM_LSB);
        end if;
      elsif step_en = '1' then
        if phaseram_we = '1' then
          phaseram_mem(to_integer(unsigned(phaseram_addr))) <= phaseram_wdata;
        end if;
        phaseram_q <= phaseram_mem(to_integer(unsigned(phaseram_addr)));
      end if;
    end if;
  end process;

  -- RAM NOISE: 64 x 3
  noise_p: process (clk)
  begin
    if rising_edge(clk) then
      if load_we = '1' then
        if unsigned(load_addr(10 downto 6)) = NOISE_BASE / 64 then
          noise_mem(to_integer(unsigned(load_addr(5 downto 0)))) <= load_data(NOISE_LSB + 2 downto NOISE_LSB);
        end if;
      elsif step_en = '1' then
        if noise_we = '1' then
          noise_mem(to_integer(unsigned(noise_addr))) <= noise_wdata;
        end if;
        noise_q <= noise_mem(to_integer(unsigned(noise_addr)));
      end if;
    end if;
  end process;

  -- RAM LHPRAM: 64 x 1
  lhpram_p: process (clk)
  begin
    if rising_edge(clk) then
      if load_we = '1' then
        if unsigned(load_addr(10 downto 6)) = LHPRAM_BASE / 64 then
          lhpram_mem(to_integer(unsigned(load_addr(5 downto 0)))) <= load_data(LHPRAM_LSB + 0 downto LHPRAM_LSB);
        end if;
      elsif step_en = '1' then
        if lhpram_we = '1' then
          lhpram_mem(to_integer(unsigned(lhpram_addr))) <= lhpram_wdata;
        end if;
        lhpram_q <= lhpram_mem(to_integer(unsigned(lhpram_addr)));
      end if;
    end if;
  end process;

  -- RAM HARMBRKPOINT: 64 x 16
  harmbrkpoint_p: process (clk)
  begin
    if rising_edge(clk) then
      if load_we = '1' then
        if unsigned(load_addr(10 downto 6)) = HARMBRKPOINT_BASE / 64 then
          harmbrkpoint_mem(to_integer(unsigned(load_addr(5 downto 0)))) <= load_data(HARMBRKPOINT_LSB + 15 downto HARMBRKPOINT_LSB);
        end if;
      elsif step_en = '1' then
        if harmbrkpoint_we = '1' then
          harmbrkpoint_mem(to_integer(unsigned(harmbrkpoint_addr))) <= harmbrkpoint_wdata;
        end if;
        harmbrkpoint_q <= harmbrkpoint_mem(to_integer(unsigned(harmbrkpoint_addr)));
      end if;
    end if;
  end process;

  -- RAM HARMCURNTVAL: 64 x 13
  harmcurntval_p: process (clk)
  begin
    if rising_edge(clk) then
      if load_we = '1' then
        if unsigned(load_addr(10 downto 6)) = HARMCURNTVAL_BASE / 64 then
          harmcurntval_mem(to_integer(unsigned(load_addr(5 downto 0)))) <= load_data(HARMCURNTVAL_LSB + 12 downto HARMCURNTVAL_LSB);
        end if;
      elsif step_en = '1' then
        if harmcurntval_we = '1' then
          harmcurntval_mem(to_integer(unsigned(harmcurntval_addr))) <= harmcurntval_wdata;
        end if;
        harmcurntval_q <= harmcurntval_mem(to_integer(unsigned(harmcurntval_addr)));
      end if;
    end if;
  end process;

  -- RAM VOICE18: 16 x 18
  voice18_p: process (clk)
  begin
    if rising_edge(clk) then
      if load_we = '1' then
        if unsigned(load_addr(10 downto 4)) = VOICE18_BASE / 16 then
          voice18_mem(to_integer(unsigned(load_addr(3 downto 0)))) <= load_data(VOICE18_LSB + 17 downto VOICE18_LSB);
        end if;
      elsif step_en = '1' then
        if voice18_we = '1' then
          voice18_mem(to_integer(unsigned(voice18_addr))) <= voice18_wdata;
        end if;
        voice18_q <= voice18_mem(to_integer(unsigned(voice18_addr)));
      end if;
    end if;
  end process;

  -- RAM VOICE3: 16 x 3
  voice3_p: process (clk)
  begin
    if rising_edge(clk) then
      if load_we = '1' then
        if unsigned(load_addr(10 downto 4)) = VOICE3_BASE / 16 then
          voice3_mem(to_integer(unsigned(load_addr(3 downto 0)))) <= load_data(VOICE3_LSB + 2 downto VOICE3_LSB);
        end if;
      elsif step_en = '1' then
        if voice3_we = '1' then
          voice3_mem(to_integer(unsigned(voice3_addr))) <= voice3_wdata;
        end if;
        voice3_q <= voice3_mem(to_integer(unsigned(voice3_addr)));
      end if;
    end if;
  end process;

  -- ROM OCTSPL: 32 x 4
  octspl_p: process (clk)
  begin
    if rising_edge(clk) then
      if load_we = '1' then
        if unsigned(load_addr(10 downto 5)) = OCTSPL_BASE / 32 then
          octspl_mem(to_integer(unsigned(load_addr(4 downto 0)))) <= load_data(OCTSPL_LSB + 3 downto OCTSPL_LSB);
        end if;
      elsif step_en = '1' then
        octspl_q <= octspl_mem(to_integer(unsigned(octspl_addr)));
      end if;
    end if;
  end process;

  -- ROM XROMBS: 128 x 15
  xrombs_p: process (clk)
  begin
    if rising_edge(clk) then
      if load_we = '1' then
        if unsigned(load_addr(10 downto 7)) = XROMBS_BASE / 128 then
          xrombs_mem(to_integer(unsigned(load_addr(6 downto 0)))) <= load_data(XROMBS_LSB + 14 downto XROMBS_LSB);
        end if;
      elsif step_en = '1' then
        xrombs_q <= xrombs_mem(to_integer(unsigned(xrombs_addr)));
      end if;
    end if;
  end process;

  -- ROM XROMINT: 128 x 5
  xromint_p: process (clk)
  begin
    if rising_edge(clk) then
      if load_we = '1' then
        if unsigned(load_addr(10 downto 7)) = XROMINT_BASE / 128 then
          xromint_mem(to_integer(unsigned(load_addr(6 downto 0)))) <= load_data(XROMINT_LSB + 4 downto XROMINT_LSB);
        end if;
      elsif step_en = '1' then
        xromint_q <= xromint_mem(to_integer(unsigned(xromint_addr)));
      end if;
    end if;
  end process;

  -- ROM SROMBS: 256 x 17
  srombs_p: process (clk)
  begin
    if rising_edge(clk) then
      if load_we = '1' then
        if unsigned(load_addr(10 downto 8)) = SROMBS_BASE / 256 then
          srombs_mem(to_integer(unsigned(load_addr(7 downto 0)))) <= load_data(SROMBS_LSB + 16 downto SROMBS_LSB);
        end if;
      elsif step_en = '1' then
        srombs_q <= srombs_mem(to_integer(unsigned(srombs_addr)));
      end if;
    end if;
  end process;

  -- ROM SROMINT: 512 x 5
  sromint_p: process (clk)
  begin
    if rising_edge(clk) then
      if load_we = '1' then
        if unsigned(load_addr(10 downto 9)) = SROMINT_BASE / 512 then
          sromint_mem(to_integer(unsigned(load_addr(8 downto 0)))) <= load_data(SROMINT_LSB + 4 downto SROMINT_LSB);
        end if;
      elsif step_en = '1' then
        sromint_q <= sromint_mem(to_integer(unsigned(sromint_addr)));
      end if;
    end if;
  end process;

end architecture;
